## boards/efogtech/efogtech_trackball_0/Kconfig.efogtech_trackball_0
```kconfig
# SPDX-License-Identifier: Apache-2.0

config BOARD_EFOGTECH_TRACKBALL_0
	select SOC_NRF52833_QIAA
```

## boards/efogtech/efogtech_trackball_0/board.yml
```yaml
board:
  name: efogtech_trackball_0
  vendor: efogtech
  socs:
    - name: nrf52833
```
